#include<p16f877a.inc> 
__CONFIG _HS_OSC & _WDT_OFF & _LVP_OFF  ;Set oscillator to HS;
ORG 00H
BCF STATUS,RP0
BCF STATUS,RP1
CLRF PORTB
BSF STATUS,RP0
BCF STATUS,RP1
MOVLW 0X00
MOVWF TRISB
BCF STATUS,RP0
BCF STATUS,RP1
MOVLW D'3
MOVWF PORTB
BCF STATUS,RP0
BSF STATUS,RP1
MOVLW B'11111111
MOVWF 0XA0
MOVWF 0XA5
MOVLW B'11111111
MOVWF 0XA1
MOVWF 0XA6
MOVLW B'11111111
MOVWF 0XA2
CALL LOOP
GOTO END_1
NOP
		LOOP
					MOVF 0XA5,0
					MOVWF 0XA0
					MOVF 0XA6,0
					MOVWF 0XA1	
					DECFSZ 0XA2,1
					GOTO ON
					RETURN
				ON
					MOVLW 0X1F
					MOVWF PORTB
					DECFSZ 0XA0,1
					GOTO ON
					GOTO LOOP
NOP
END_1
END