#include<p16f877a.inc> 
__CONFIG _HS_OSC & _WDT_OFF & _LVP_OFF  ;Set oscillator to HS;
ORG 00H
BSF STATUS,RP0
BCF STATUS,RP1
MOVLW 0X00
MOVWF TRISA
BCF STATUS,RP0
BCF STATUS,RP1
MOVLW 0X2F
MOVWF PORTA
MOVLW B'11111111
MOVWF 0X21
MOVWF 0X31
MOVLW B'11111111
MOVWF 0X22
MOVWF 0X32
MOVLW B'11111111
MOVWF 0X41
CALL LOOP
GOTO END_1
NOP
		LOOP
					MOVF 0X31,0
					MOVWF 0X21
					MOVF 0X32,0
					MOVWF 0X22	
					DECFSZ 0X41,1
					GOTO ON
					RETURN
				ON
					MOVLW 0X00
					MOVWF PORTA
					DECFSZ 0X21,1
					GOTO ON
					GOTO OFF
			OFF
					CLRF PORTA
				OFF1
					MOVLW 0X00
					MOVWF PORTA
					DECFSZ 0X41,1
					GOTO OFF1
					GOTO LOOP
END_1
END