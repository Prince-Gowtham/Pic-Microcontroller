#include<p16f877a.inc>
#define  _XTAL_FREQ 20000000    
__CONFIG _HS_OSC & _WDT_OFF & _LVP_OFF 
ORG 00H
BCF STATUS,RP0
BCF STATUS,RP1
CLRF PORTB
MOVLW D'3
MOVWF PORTB
BSF STATUS,RP0
BCF STATUS,RP1
MOVLW 0X06
MOVWF ADCON1
MOVLW 0X00
MOVWF TRISB
MOVLW B'00000001
MOVWF 0XA0
MOVWF 0X22
MOVLW B'10000000
MOVWF 0X31
MOVWF 0X32
MOVLW B'00000111
MOVWF 0X23
MOVWF 0X33
MOVLW B'00000011
MOVWF 0X24
MOVWF 0X34
CALL SUBROUTINE
CALL SUBROUTINE1
GOTO END_1
NOP
SUBROUTINE:
	GOWTHAM 
		RLF 0XA0,1
		DECFSZ 0X23,1
		GOTO GOWTHAM
		MOVLW B'00000001
		MOVWF 0XA0
	GOWTHAM1
		RLF 0XA0,1
		DECFSZ 0X24,1
		GOTO GOWTHAM1
		RETURN
SUBROUTINE1:  
	GOWTHAM2
		RRF 0X31,1
		DECFSZ 0X33,1
		GOTO GOWTHAM2
		MOVLW B'10000000
		MOVWF 0X31
	GOWTHAM3
		RRF 0X31,1
		DECFSZ 0X34,1
		GOTO GOWTHAM3
		RETURN
NOP
END_1
END