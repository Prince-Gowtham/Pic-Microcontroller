#include<p16f877a.inc>
ORG 00H
#define  _XTAL_FREQ 200000000
__CONFIG(_CP_OFF&_WDT_OFF &_PWRTE_ON &_XT_OSC);
BSF STATUS,RP0
BCF STATUS,RP1 	;BANK 1
MOVLW 0X00
MOVWF TRISB
MOVLW B'00000001
MOVWF  PIE1
BCF STATUS,RP0 	  ;BANK 0
;MOVLW B'11000000
;MOVWF INTCON	
MOVLW B'00111001
MOVWF T1CON   ;TMR 1 ENABLING AND PRESCALER
MOVLW 0XB0                                    
MOVWF TMR1H    ;TMR1 MSB BIT SETTING
MOVLW 0XDC                             
MOVWF TMR1L  ;TMR1 LSB BIT SETTING
MOVLW B'00000001 
MOVWF 0X33  
MOVLW B'00001010
MOVWF 0X32      ;IT IS 100MS SECONDS SO WE NEED TO LOOP 10 TIMES
MOVWF 0X31
MOVF 0X33,0
CALL ON
NOP
END_1			
				GOWTHAM:
					RLF 0X33,1
					MOVF 0X33,0
					DECFSZ 0X32,1
					GOTO ON
					GOTO END_1
					ON	
						MOVWF PORTB
						BTFSS PIR1 ,0
						GOTO ON
						GOTO SWITCH
					SWITCH
						MOVLW B'00000000
						MOVWF PIR1
						MOVLW B'11011100                             
						MOVWF TMR1L  ;TMR1 LSB BIT SETTING
						MOVLW B'10110000                                           
						MOVWF TMR1H ;TMR1 MSB BIT SETTING
						GOTO GOWTHAM
NOP
END