#INCLUDE<p16f877a.inc>
ORG 00H 
__CONFIG _HS_OSC & _WDT_OFF & _LVP_OFF
BSF STATUS,RP0
BCF STATUS,RP1
MOVLW 0X00
MOVWF TRISB
BCF STATUS,RP0
MOVLW 0xFF
MOVWF PORTB					
MOVLW B'00000011   
MOVWF 0X41
MOVLW B'01000000 			 
MOVWF 0X20
MOVWF 0X42
MOVWF 0X43
MOVLW B'00000010
MOVWF 0X51
CALL SUBROUTINE
CALL GOWTHAM1
GOTO END_1 
NOP
		SUBROUTINE:
					GOWTHAM
							RRF 0X42
							RRF 0X42
							MOVF 0X42,0
							MOVWF 0X20
							DECFSZ 0X41,1
							GOTO GOWTHAM
							RETURN
		GOWTHAM1
					MOVF 0X43,0
					MOVWF 0X42
					MOVWF 0X20
				GOWTHAM2
					RRF 0X42
					RRF 0X42
					MOVF 0X42,0
					MOVWF 0X20
					DECFSZ 0X51,1
					GOTO GOWTHAM2	
					RETURN
END_1
END