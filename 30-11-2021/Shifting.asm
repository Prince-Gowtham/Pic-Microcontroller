#include<p16f877a.inc>
ORG 00H
BSF STATUS,RP0
BCF STATUS,RP1
MOVLW 0X00
MOVWF TRISB
MOVLW B'00000100
MOVWF  OPTION_REG
BCF STATUS,RP0
MOVLW B'11100100
MOVWF INTCON
MOVLW B'01100100
MOVWF  TMR0
MOVLW 0X01
MOVWF 0X33
CALL GOWTHAM
GOTO END_1
NOP
END_1			
				GOWTHAM:
						MOVLW 0XFF
						MOVWF 0X21
						MOVWF 0X22
						MOVWF 0X23
						MOVF 0X33,0
						GOTO ON
					ON	
						MOVWF PORTB
						DECFSZ 0X21,1
						GOTO ON
						GOTO ON1
					ON1
						MOVWF PORTB
						DECFSZ 0X22,1
						GOTO ON1
						GOTO ON2
					ON2	
						MOVWF PORTB
						DECFSZ 0X23,1
						GOTO ON2
						GOTO SWITCH
					SWITCH
						RLF 0X33,1
						GOTO GOWTHAM
NOP
END