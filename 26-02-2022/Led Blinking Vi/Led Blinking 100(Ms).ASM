
#include<p16f877a.inc>
	ORG 00H
	GOTO 05H
	ORG 05H
		;BANK SWITCHING
	BSF STATUS,RP0
	BCF STATUS,RP1
		;ENABLE THE TRIS PIN AS A OUTPUT
	MOVLW 0X00
	MOVWF TRISB
		;DISABLING INTEREPTS	
	MOVLW 0X00
	MOVWF PIE1
		;BANK1 SWITCHING TO BANK 0
	BCF STATUS,RP0
		;T1CON ENABLING 
	MOVLW 0X31
	MOVWF T1CON
		;RESETING THE OVERFLOW BIT
	MOVLW 0X00
	MOVWF PIR1
		;SETTING THE DELAY TIMEING COUNT 	
	MOVLW 0XDC
	MOVWF TMR1L
	MOVLW 0X0B
	MOVWF TMR1H
	CALL LOOP_1
	CALL GOW
GOW;
			GOTO GOW
	NOP			
LOOP_1:
	MOVLW 0X01
	MOVWF 0X31
	MOVLW 0X00;MANUALLY RESETING THE OVERFLOW BIT 
	MOVWF PIR1
	MOVLW 0XDC;SETTING THE TMR1 VALUES USING TMR1L TMR1H
	MOVWF TMR1L
	MOVLW 0X0B
	GOTO SWITCH
SWITCH:
	;PORTB CONFIGUREING ENABLEING BIT
	;IF OVERFLOW FLAG WILL SET IN THIS CONDITION SKIP THE GOTO SWITCH
	MOVF 0X31,1
	MOVWF PORTB
	BTFSS 	PIR1,0  
	GOTO 	SWITCH
SWITCH1:
	MOVLW 0X00;MANUALLY RESETING THE OVERFLOW BIT 
	MOVWF PIR1
	MOVLW 0XDC;SETTING THE TMR1 VALUES USING TMR1L TMR1H
	MOVWF TMR1L
	MOVLW 0X0B
	MOVWF TMR1H
SWITCH2:	
	;WE ARE CLEARING THE PORTB PIN OFF THE LED IN 100MS 
	MOVLW 0X00
	MOVWF PORTB
	BTFSS PIR1,0
	GOTO SWITCH2
	GOTO LOOP_1
	RETURN
END_1	
	END