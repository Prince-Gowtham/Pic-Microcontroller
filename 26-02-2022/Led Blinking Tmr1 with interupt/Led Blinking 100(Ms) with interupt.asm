
#include<p16f877a.inc>
	ORG 00H
	GOTO LABLE

	ORG 04H
	;INTERRRUPT SERVICE ROUTINE START
		;DISABLING ALL INTERUPT 
	BCF INTCON,7
		;MANUALLY RESETING THE OVERFLOW BIT  
	BCF PIR1,0  	
		;BIT SKIP IF SET	
	BTFSS PORTB,0
		; GOTO PROGRAM COUNTER +3 IT GOES BSF PORTB 
	GOTO $+3 
		;BIT CLEAR PORTB
	BCF PORTB,0
		; GOTO PROGRAM COUNTER +2 IT GOES BSF PORTB
	GOTO $+2 	
		;BIT SET PORTB ENABLING
	BSF PORTB,0 
		;MANUALLY DISABLING TMR1
	BCF T1CON,0 
		;SETTING THE TMR1 VALUES USING TMR1L TMR1H
	MOVLW 0XDC 
	MOVWF TMR1L
	MOVLW 0X0B
	MOVWF TMR1H
		 ;MANUALLY ENAABLING TMR1	
	BSF T1CON,0 
		 ;ENABLING ALL INTERUPT
	BSF INTCON,7
	RETFIE
	;END OF INTERRUPT SERVICE ROUTINE	

LABLE:
	NOP	
		;GLOBAL INTERUPT BIT DISBLE 
	BCF INTCON,7 
		;BANK SWITCHING
	BSF STATUS,RP0
	BCF STATUS,RP1
		;ENABLE THE TRIS PIN AS A OUTPUT
	BCF TRISB,0	
		;BANK1 SWITCHING TO BANK 0
	BCF STATUS,RP0
		;RESETING THE OVERFLOW BIT
	BCF PIR1,0
		;STOPS TMR1	 
	BCF T1CON,0
		;SETTING THE DELAY TIMEING COUNT 
	MOVLW 0XDC
	MOVWF TMR1L
	MOVLW 0X0B
	MOVWF TMR1H
		;TMR1 INTERUPT ENABLING
	BSF STATUS,RP0
	BSF PIE1,0 ;
	BCF STATUS,RP0
		;SETTING PRESCALLER VALUES
	MOVLW 0X30
	MOVWF T1CON
		;ENABLING THE GLOBAL INTERUPT BIT,PEIE ENABLEING
	MOVLW 0XC0
	MOVWF INTCON
		;T1CON ENABLING,TMR1 ENABLE AND PRESCALER VALUE ENABLE 
	BSF T1CON,0
GOW:
			GOTO GOW

END_1	
  	END